## conf/bblayers.conf
```bitbake
LCONF_VERSION = "7"

BBPATH = "${TOPDIR}"
BSPDIR := "${@os.path.abspath(os.path.dirname(d.getVar('FILE', True)) + '/../..')}"

BBFILES ?= ""
BBLAYERS = " \
  ${BSPDIR}/sources/poky/meta \
  ${BSPDIR}/sources/meta-openembedded/meta-oe \
  ${BSPDIR}/sources/meta-openembedded/meta-python \
  ${BSPDIR}/sources/meta-openembedded/meta-webserver \
  ${BSPDIR}/sources/meta-qt5 \
  ${BSPDIR}/sources/meta-mainline-common \
  ${BSPDIR}/sources/meta-mainline-graphics \
  ${BSPDIR}/sources/meta-dhsom-stm32-bsp \
  ${BSPDIR}/sources/meta-dhsom-stm32-extras \
  ${BSPDIR}/sources/meta-dhsom-stm32-common\
  ${BSPDIR}/sources/meta-python2 \
  ${BSPDIR}/sources/meta-swupdate \
"
```

## conf/distro/dhlinux-swupdate.conf
```bitbake
require conf/distro/dhlinux.conf


DISTRO = "dhlinux-swupdate"
DISTRO_NAME = "DHCOM swupdate"

DISTRO_FEATURES_append = " sysvinit"
```

## conf/layer.conf
```bitbake
# We have a conf and classes directory, add to BBPATH
BBPATH .= ":${LAYERDIR}"

# We have recipes-* directories, add to BBFILES
BBFILES += "${LAYERDIR}/recipes-*/*/*.bb \
            ${LAYERDIR}/recipes-*/*/*.bbappend"

BBFILE_COLLECTIONS += "meta-dhsom-stm32-common"
BBFILE_PATTERN_meta-dhsom-stm32-common = "^${LAYERDIR}/"
BBFILE_PRIORITY_meta-dhsom-stm32-common = "6"

LAYERDEPENDS_meta-dhsom-stm32-common = "core"
LAYERSERIES_COMPAT_meta-dhsom-stm32-common = "warrior zeus dunfell"

BBFILES_DYNAMIC += " \
	swupdate:${LAYERDIR}/dynamic-layers/swupdate/*/*/*.bb \
	swupdate:${LAYERDIR}/dynamic-layers/swupdate/*/*/*.bbappend \
	"
```

## conf/machine/dh-stm32mp1-dhcom-common-drc02.conf
```bitbake
#@TYPE: Machine
#@NAME: DH STM32MP1 DHCOM SoM on DRC02 carrier board
#@SOC:  ST STM32MP1
#@DESCRIPTION: Machine configuration for DH STM32MP1 DHCOM SoM on DRC02 carrier board

require conf/machine/include/dh-stm32mp1-common.inc

MACHINEOVERRIDES_append=":dh-stm32mp1-dhcom-drc02:dh-stm32mp1-dhcom-common-drc02:"

# U-Boot bootloader
UBOOT_MACHINE = "stm32mp15_dhcom_basic_defconfig"

# U-Boot

PREFERRED_PROVIDER_virtual/bootloader = "u-boot-stm32mp1-dhsom"
PREFERRED_PROVIDER_u-boot = "u-boot-stm32mp1-dhsom"
PREFERRED_PROVIDER_u-boot-native = "u-boot-stm32mp1-dhsom"
PREFERRED_PROVIDER_u-boot-fw-utils = "u-boot-stm32mp1-dhsom-fw-utils"
PREFERRED_PROVIDER_u-boot-fw-utils-native = "u-boot-stm32mp1-dhsom-fw-utils-native"
PREFERRED_VERSION_u-boot = "2021.01%"
PREFERRED_VERSION_u-boot-native = "2021.01%"
PREFERRED_VERSION_u-boot-fw-utils = "2021.01%"
PREFERRED_VERSION_u-boot-fw-utils-native = "2021.01%"

# Linux kernel
KERNEL_DEVICETREE = " \
	stm32mp153c-dhcom-drc02.dtb \
	"

KERNEL_DEFCONFIG = "stm32mp1_dhsom_defconfig"
PREFERRED_PROVIDER_virtual/kernel = "linux-stm32mp1-dhsom"
PREFERRED_VERSION_linux-stm32mp1-dhsom = "5.10%"
```

## conf/machine/dh-stm32mp1-dhcom-common-pdk2-rt.conf
```bitbake
require conf/machine/dh-stm32mp1-dhcom-pdk2.conf
require conf/machine/include/dh-stm32mp1-common-rt.inc
MACHINEOVERRIDES_append=":dh-stm32mp1-dhcom-pdk2:"

KERNEL_DEFCONFIG = "stm32mp1_dhsom_defconfig"
```

## conf/machine/dh-stm32mp1-dhcom-common-pdk2.conf
```bitbake
#@TYPE: Machine
#@NAME: DH STM32MP1 DHCOM SoM on PDK2 carrier board
#@SOC:  ST STM32MP1
#@DESCRIPTION: Machine configuration for DH STM32MP1 DHCOM SoM on PDK2 carrier board

require conf/machine/include/dh-stm32mp1-common.inc
MACHINEOVERRIDES_append=":dh-stm32mp1-dhcom-pdk2:dh-stm32mp1-dhcom-common-pdk2:"

# U-Boot bootloader
UBOOT_MACHINE = "stm32mp15_dhcom_basic_defconfig"

# U-Boot

PREFERRED_PROVIDER_virtual/bootloader = "u-boot-stm32mp1-dhsom"
PREFERRED_PROVIDER_u-boot = "u-boot-stm32mp1-dhsom"
PREFERRED_PROVIDER_u-boot-native = "u-boot-stm32mp1-dhsom"
PREFERRED_PROVIDER_u-boot-fw-utils = "u-boot-stm32mp1-dhsom-fw-utils"
PREFERRED_PROVIDER_u-boot-fw-utils-native = "u-boot-stm32mp1-dhsom-fw-utils-native"
PREFERRED_VERSION_u-boot = "2021.01%"
PREFERRED_VERSION_u-boot-native = "2021.01%"
PREFERRED_VERSION_u-boot-fw-utils = "2021.01%"
PREFERRED_VERSION_u-boot-fw-utils-native = "2021.01%"

# Linux kernel
KERNEL_DEVICETREE = " \
	stm32mp157c-dhcom-pdk2.dtb \
	stm32mp15xx-dhcom-pdk2-overlay-spi1.dtbo \
	stm32mp15xx-dhcom-pdk2-overlay-460-200-x11.dtbo \
	stm32mp15xx-dhcom-pdk2-overlay-497-200-x12.dtbo \
	stm32mp15xx-dhcom-pdk2-overlay-531-100-x21.dtbo \
	stm32mp15xx-dhcom-pdk2-overlay-531-100-x22.dtbo \
	stm32mp15xx-dhcom-pdk2-overlay-505-200-x12-ch101olhlwh.dtbo \
	stm32mp15xx-dhcom-pdk2-overlay-560-200-x12.dtbo \
	stm32mp15xx-dhcom-pdk2-overlay-638-100-x12-rpi7inch.dtbo \
	stm32mp15xx-dhcom-pdk2-overlay-672-100-x18.dtbo \
	"

KERNEL_DEFCONFIG = "stm32mp1_dhsom_defconfig"
PREFERRED_PROVIDER_virtual/kernel = "linux-stm32mp1-dhsom"
PREFERRED_VERSION_linux-stm32mp1-dhsom = "5.10%"
INITRAMFS_IMAGE="core-image-swupdate"
# Ship kernel modules
MACHINE_ESSENTIAL_EXTRA_RDEPENDS += " linux-firmware-rs9116 "


# Ship kernel modules
MACHINE_ESSENTIAL_EXTRA_RDEPENDS += " linux-firmware-rs9116 "
```

## conf/machine/dh-stm32mp1-dhcom-common-picoitx-rt.conf
```bitbake
require conf/machine/dh-stm32mp1-dhcom-picoitx.conf
require conf/machine/include/dh-stm32mp1-common-rt.inc

KERNEL_DEFCONFIG = "stm32mp1_dhsom_defconfig"
```

## conf/machine/dh-stm32mp1-dhcom-drc02-extra.conf
```bitbake
MACHINEOVERRIDES_append=":dh-stm32mp1-dhcom-drc02:dh-stm32mp1-dhcom-common-drc02:"
```

## conf/machine/dh-stm32mp1-dhcom-pdk2-extra.conf
```bitbake
MACHINEOVERRIDES_append=":dh-stm32mp1-dhcom-pdk2:dh-stm32mp1-dhcom-common-pdk2:"
```

## conf/machine/dh-stm32mp1-dhcom-pdk2-update.conf
```bitbake
require conf/machine/dh-stm32mp1-dhcom-pdk2.conf
MACHINEOVERRIDES_append=":dh-stm32mp1-dhcom-pdk2:"

INITRAMFS_IMAGE="core-image-swupdate"
```

## conf/machine/dh-stm32mp1-dhcom-picoitx-extra.conf
```bitbake
MACHINEOVERRIDES_append=":dh-stm32mp1-dhcom-picoitx:dh-stm32mp1-dhcom-common-picoitx:"
```

## conf/machine/dh-stm32mp1-dhcor-avenger96-extra.conf
```bitbake
MACHINEOVERRIDES_append=":dh-stm32mp1-dhcor-avenger96:dh-stm32mp1-dhcor-common-avenger96:"
```

## conf/machine/dh-stm32mp1-dhcor-common-avenger96-rt.conf
```bitbake
require conf/machine/dh-stm32mp1-dhcor-avenger96.conf
require conf/machine/include/dh-stm32mp1-common-rt.inc
MACHINEOVERRIDES_append=":dh-stm32mp1-dhcor-avenger96:"


KERNEL_DEFCONFIG = "stm32mp1_dhsom_defconfig"
```

## conf/machine/dh-stm32mp1-dhcor-common-avenger96.conf
```bitbake
#@TYPE: Machine
#@NAME: DH STM32MP1 DHCOM SoM on Avenger96 carrier board
#@SOC:  ST STM32MP1
#@DESCRIPTION: Machine configuration for DH STM32MP1 DHCOM SoM on Avenger96 carrier board

require conf/machine/include/dh-stm32mp1-common.inc

MACHINEOVERRIDES_append=":dh-stm32mp1-dhcor-avenger96:dh-stm32mp1-dhcor-common-avenger96:"

# U-Boot bootloader
UBOOT_MACHINE = "stm32mp15_dhcor_basic_defconfig"

# U-Boot

PREFERRED_PROVIDER_virtual/bootloader = "u-boot-stm32mp1-dhsom"
PREFERRED_PROVIDER_u-boot = "u-boot-stm32mp1-dhsom"
PREFERRED_PROVIDER_u-boot-native = "u-boot-stm32mp1-dhsom"
PREFERRED_PROVIDER_u-boot-fw-utils = "u-boot-stm32mp1-dhsom-fw-utils"
PREFERRED_PROVIDER_u-boot-fw-utils-native = "u-boot-stm32mp1-dhsom-fw-utils-native"
PREFERRED_VERSION_u-boot = "2021.01%"
PREFERRED_VERSION_u-boot-native = "2021.01%"
PREFERRED_VERSION_u-boot-fw-utils = "2021.01%"
PREFERRED_VERSION_u-boot-fw-utils-native = "2021.01%"

# Linux kernel
KERNEL_DEVICETREE = " \
	stm32mp157a-avenger96.dtb \
	stm32mp15xx-avenger96-overlay-644-100-x6-otm8009a.dtbo \
	stm32mp15xx-avenger96-overlay-644-100-x6-rpi7inch.dtbo \
	stm32mp15xx-avenger96-overlay-fdcan1-x6.dtbo \
	stm32mp15xx-avenger96-overlay-fdcan2-x6.dtbo \
	stm32mp15xx-avenger96-overlay-i2c1-eeprom-x6.dtbo \
	stm32mp15xx-avenger96-overlay-i2c2-eeprom-x6.dtbo \
	stm32mp15xx-avenger96-overlay-ov5640-x7.dtbo \
	stm32mp15xx-avenger96-overlay-spi2-eeprom-x6.dtbo \
	"

KERNEL_DEFCONFIG = "stm32mp1_dhsom_defconfig"
PREFERRED_PROVIDER_virtual/kernel = "linux-stm32mp1-dhsom"
PREFERRED_VERSION_linux-stm32mp1-dhsom = "5.10%"


# Ship kernel modules
MACHINE_ESSENTIAL_EXTRA_RDEPENDS += " \
	cypress-firmware-bcm43xx-bt-patch-bcm4345c0 \
	cypress-firmware-bcm43xx-fmac-fw-bcm43455-1mw-sdio \
	cypress-firmware-bcm43xx-fmac-nvram-bcm43455-1mw-sdio \
	"
```

## conf/machine/dhsomstm32mp1.conf
```bitbake
#@TYPE: Machine
#@NAME: DHSOM STM32MP1
#@SOC:  ST STM32MP1
#@DESCRIPTION: Machine configuration for DHSOM STM32MP1


require conf/machine/mainlinestm32mp1.conf

MACHINE_FEATURES ?= "apm alsa ext2 keyboard screen serial touchscreen usbgadget usbhost"

SERIAL_CONSOLE = "115200 ttySTM0"

# U-Boot bootloader
UBOOT_ENTRYPOINT := "0xc4000000"
UBOOT_MACHINE = "stm32mp15_dhcom_basic_defconfig"
UBOOT_BINARY := "u-boot.img"
UBOOT_SUFFIX ?= "img"
SPL_BINARY := "u-boot-spl.stm32"
UBOOT_ENV = "boot"
UBOOT_ENV_SUFFIX = "scr"
PREFERRED_PROVIDER_virtual/bootloader = "u-boot-stm32mp1-dhsom"
PREFERRED_VERSION_u-boot ?= "2020.01%"
PREFERRED_VERSION_u-boot-mkimage ?= "2020.01%"

# Linux kernel
KERNEL_IMAGETYPE = "fitImage"
KERNEL_CLASSES += " kernel-fitimage "
KERNEL_DEVICETREE = "stm32mp157c-dhcom-pdk2.dtb"
KERNEL_DEFCONFIG = "stm32mp1_dhsom_defconfig"
KERNEL_MODULES_AUTOLOAD += " etnaviv "

PREFERRED_PROVIDER_virtual/kernel = "linux-stm32mp1-dhsom"
PREFERRED_VERSION_linux-yocto = "5.4%"

# Ship kernel modules
MACHINE_ESSENTIAL_EXTRA_RDEPENDS = "kernel-modules kernel-devicetree linux-firmware-rs9116 u-boot"

# List of images to be built
IMAGE_FSTYPES = "tar.gz wic.gz"
INITRAMFS_FSTYPES ?= "cpio.xz"

WKS_FILE = "sdimage-mainlinestm32mp1.wks"
IMAGE_BOOT_FILES ?= "${KERNEL_IMAGETYPE}"
IMAGE_INSTALL_append = " kernel-devicetree kernel-image-fitimage"
do_image_wic[depends] += "mtools-native:do_populate_sysroot dosfstools-native:do_populate_sysroot"
```

## conf/machine/include/dh-stm32mp1-common-extra.inc
```bitbake
# U-Boot
PREFERRED_PROVIDER_virtual/bootloader = "u-boot-stm32mp1-dhsom"
PREFERRED_PROVIDER_u-boot = "u-boot-stm32mp1-dhsom"
PREFERRED_PROVIDER_u-boot-native = "u-boot-stm32mp1-dhsom"
PREFERRED_PROVIDER_u-boot-fw-utils = "u-boot-stm32mp1-dhsom-fw-utils"
PREFERRED_PROVIDER_u-boot-fw-utils-native = "u-boot-stm32mp1-dhsom-fw-utils-native"
PREFERRED_VERSION_u-boot = "2021.01%"
PREFERRED_VERSION_u-boot-native = "2021.01%"
PREFERRED_VERSION_u-boot-fw-utils = "2021.01%"
PREFERRED_VERSION_u-boot-fw-utils-native = "2021.01%"

# Linux
KERNEL_DEFCONFIG = "stm32mp1_dhsom_defconfig"
PREFERRED_PROVIDER_virtual/kernel = "linux-stm32mp1-dhsom"
PREFERRED_VERSION_linux-stm32mp1-dhsom = "5.10%"
```

## conf/machine/include/dh-stm32mp1-common-rt.inc
```bitbake
# U-Boot
PREFERRED_PROVIDER_virtual/bootloader = "u-boot-stm32mp1-dhsom"
PREFERRED_PROVIDER_u-boot = "u-boot-stm32mp1-dhsom"
PREFERRED_PROVIDER_u-boot-native = "u-boot-stm32mp1-dhsom"
PREFERRED_PROVIDER_u-boot-fw-utils = "u-boot-stm32mp1-dhsom-fw-utils"
PREFERRED_PROVIDER_u-boot-fw-utils-native = "u-boot-stm32mp1-dhsom-fw-utils-native"
PREFERRED_VERSION_u-boot = "2020.07%"
PREFERRED_VERSION_u-boot-native = "2020.07%"
PREFERRED_VERSION_u-boot-fw-utils = "2020.07%"
PREFERRED_VERSION_u-boot-fw-utils-native = "2020.07%"

# Linux
PREFERRED_PROVIDER_virtual/kernel = "linux-stm32mp1-dhsom-rt"
PREFERRED_VERSION_linux-stm32mp1-dhsom = "5.4%"
```
